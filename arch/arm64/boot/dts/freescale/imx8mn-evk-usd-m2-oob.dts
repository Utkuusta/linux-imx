// SPDX-License-Identifier: (GPL-2.0+ OR MIT)
/*
 * Copyright 2019 NXP
 */

#include "imx8mn-evk-usd-m2.dts"

&pinctrl_usdhc2_gpio {
	fsl,pins = <
    		MX8MN_IOMUXC_GPIO1_IO15_GPIO1_IO15	0x1c4
		MX8MN_IOMUXC_ECSPI2_MOSI_GPIO5_IO11	0x19  /* WL_REG_ON */
    		MX8MN_IOMUXC_ECSPI2_MISO_GPIO5_IO12	0x19  /* BT_REG_ON */
    		MX8MN_IOMUXC_GPIO1_IO04_GPIO1_IO4	0x1d0 /* Murata -- should be pull-up on this */
    		MX8MN_IOMUXC_ECSPI2_SCLK_GPIO5_IO10 	0x1d0 /* Murata WL_HOST_WAKE -- pull-up */
	>;
};

&usdhc2 {
	#address-cells = <1>;
	#size-cells = <0>;
	pinctrl-assert-gpios = <&gpio1 4 GPIO_ACTIVE_HIGH>; /* Force 1.8V VIO */
	/delete-property/ cd-gpios;
	mmc-pwrseq = <&usdhc2_pwrseq>;
	pm-ignore-notify;
	keep-power-in-suspend;
	non-removable;
	cap-power-off-card;
	brcmf2: bcrmf@1 {
		reg = <1>;
		compatible = "brcm,bcm4329-fmac";
	  	interrupt-parent = <&gpio5>;
    		interrupts = <10 IRQ_TYPE_LEVEL_LOW>;
    		interrupt-names = "host-wake";
	};
};
