// SPDX-License-Identifier: (GPL-2.0+ OR MIT)
/*
 * Copyright 2019 NXP
 */

/*
 * DTS for V1R0 SOM and V1R0 Carrier Board.
 * Difference from normal V1R0 dts file is atmega328p reset pin.
 */

/dts-v1/;

#include "imx8mm-invsom-v1r1.dts"

&iomuxc {
	/delete-node/ pinctrl_hog_1; // delete MX8MM_IOMUXC_GPIO1_IO15_GPIO1_IO15 to use ccm2

	pinctrl_hog_1: hoggrp-1 {
		fsl,pins = <
		    MX8MM_IOMUXC_ECSPI2_SS0_GPIO5_IO13     0x184 // V1R0 arduino atmega328p reset pin.V1R0'da canbus ile ayni.
			MX8MM_IOMUXC_GPIO1_IO12_GPIO1_IO12	   0x184
			MX8MM_IOMUXC_SAI2_RXFS_GPIO4_IO21	   0x00000016
		>;
	};
	
	/delete-node/ pinctrl_ecspi2; // disable MX8MM_IOMUXC_ECSPI2_SS0_ECSPI2_SS0 to use arduino reset pin
	
	pinctrl_ecspi2: ecspi2grp { // CAN
		fsl,pins = <
		        MX8MM_IOMUXC_ECSPI2_MISO_ECSPI2_MISO       0x140
		        MX8MM_IOMUXC_ECSPI2_MOSI_ECSPI2_MOSI       0x140
		        MX8MM_IOMUXC_ECSPI2_SCLK_ECSPI2_SCLK       0x140
		        //MX8MM_IOMUXC_ECSPI2_SS0_ECSPI2_SS0	   0x140
		>;
	};	
	
	pinctrl_ccm2: ccm2grp {
		fsl,pins = <
			MX8MM_IOMUXC_GPIO1_IO15_CCMSRCGPCMIX_CLKO2	0x1c4
		>;
	};	
};